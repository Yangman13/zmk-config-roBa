## config/west.yml
```yaml
manifest:
  remotes:
    - name: zmkfirmware
      url-base: https://github.com/zmkfirmware
    - name: kumamuk-git
      url-base: https://github.com/kumamuk-git
    - name: caksoylar  # <-- new entry
      url-base: https://github.com/caksoylar
    - name: cormoran
      url-base: https://github.com/cormoran
  projects:
    - name: zmk
      remote: cormoran
      revision: v0.3-branch+dya
      import: app/west.yml
    - name: zmk-pmw3610-driver
      remote: kumamuk-git
      revision: main
    #- name: zmk-rgbled-widget  # <-- new entry
      #url: https://github.com/caksoylar/zmk-rgbled-widget
      #revision: main           # MUST match your ZMK version!
    - name: zmk-module-ble-management
      remote: cormoran
      revision: main

    - name: zmk-module-battery-history
      remote: cormoran
      revision: main

    - name: zmk-module-settings-rpc
      remote: cormoran
      revision: main

    - name: zmk-module-runtime-input-processor
      url: https://github.com/Yangman13/zmk-module-runtime-input-processor
      revision: main
    - name: zmk-behavior-runtime-sensor-rotate
      remote: cormoran
      revision: main
  self:
    path: config
- name: zmk-module-runtime-input-processor
      url: https://github.com/Yangman13/zmk-module-runtime-input-processor
      revision: main

# cache-buster: force refresh modules v1  # ← このコメントを1行追加する！
```
